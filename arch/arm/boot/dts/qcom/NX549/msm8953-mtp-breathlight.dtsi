/* Copyright (c) 2014, The Linux Foundation. All rights reserved.
 *
 * This program is free software; you can redistribute it and/or modify
 * it under the terms of the GNU General Public License version 2 and
 * only version 2 as published by the Free Software Foundation.
 *
 * This program is distributed in the hope that it will be useful,
 * but WITHOUT ANY WARRANTY; without even the implied warranty of
 * MERCHANTABILITY or FITNESS FOR A PARTICULAR PURPOSE.  See the
 * GNU General Public License for more details.
 */

&soc {
	i2c@78b6000 { /* BLSP1 QUP3 */
        aw2013_led@45 {
        	aw2013_led,name = "aw2013";
           	compatible = "aw2013";
           	reg = <0x45>;
		vdd_ana-supply = <&pm8953_l10>; 
		vcc_i2c-supply = <&pm8953_l5>;
		aw2013-irq-gpio = <&tlmm 36 0x00>;
		/*For adjust the brightness range,
		 values range form 1 to 5.
		 */
		middle_grade_percentage = <200>;
		side_grade_percentage = <200>;
		grade_scale-offset = <130>;
		blink_max_grade = <255>;
		onceblink_fade_time = <1>;
		onceblink_fullon_time= <0>;
		onceblink_fulloff_time= <0>;
		autoblink_fade_time= <4>;
		autoblink_fullon_time= <0>;
		autoblink_fulloff_time= <2>;
		max_current = <0x02>;
	};
	};
};
