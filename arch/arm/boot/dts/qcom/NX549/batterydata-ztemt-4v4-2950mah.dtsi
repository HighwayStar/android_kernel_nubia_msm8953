
//zte_nx508j_2850mah_averaged_masterslave_dec10th2014

qcom,atl-batterydata  {
	qcom,fcc-mah = <2950>;
	qcom,rbatt-capacitive-mohm = <50>;
	qcom,default-rbatt-mohm = <128>;
	qcom,max-voltage-uv = <4400000>;
	qcom,nom-batt-capacity-mah = <2950>;
	qcom,v-cutoff-uv = <3400000>;
	qcom,chg-term-ua = <100000>;
	qcom,batt-id-kohm = <15>;
	qcom,battery-beta = <4050>;
	qcom,chg-rslow-comp-c1 = <3148603>;
	qcom,chg-rslow-comp-c2 = <4467203>;
	qcom,chg-rs-to-rslow = <1275266>;
	qcom,chg-rslow-comp-thr = <0xA5>;
	qcom,checksum = <0x597A>;
	qcom,gui-version = "PMI8950GUI - 2.0.0.16";
	qcom,battery-type = "ztemt_atl_2950mah";
	
	qcom,fg-profile-data = [
		 E0 83 CF 7C 
		 1F 81 5F 77 
		 65 83 74 74 
		 7D 89 83 94 
		 34 82 E5 98 
		 B0 B6 DF C1 
		 56 11 9E 83 
		 90 74 AF 7A 
		 2C 74 41 83 
		 4C 78 54 84 
		 4A 7B 6F 82 
		 4F 98 73 B6 
		 72 C2 70 0F 
		 7C 0B 1E 5A 
		 14 70 71 FD 
		 8B 35 BE 45 
		 5F 40 00 00 
		 71 4C AA 31 
		 6E 43 00 00 
		 00 00 00 00 
		 00 00 00 00 
		 8C 71 7D 70 
		 05 5A BD 88 
		 BD 74 E5 61 
		 FF 64 0E 79 
		 30 6E 36 52 
		 CC 6D 08 A9 
		 1D 88 68 8F 
		 67 A0 71 0C 
		 28 00 FF 36 
		 F0 11 30 03 
		 00 00 00 0C 
	];
};
