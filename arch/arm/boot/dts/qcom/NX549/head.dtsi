#include "msm8953.dtsi"
#include "msm8953-pinctrl.dtsi"
#include "msm-audio.dtsi"
#include "msm8953-audio.dtsi"
#include "msm8953-camera.dtsi"
#include "msm8953-camera-sensor-mtp-delete.dtsi"
#include "msm8953-camera-sensor-mtp.dtsi"
#include "msm8953-mdss.dtsi"
#include "msm8953-mdss-panels.dtsi"
#include "msm8953-mtp-breathlight.dtsi"
#include "msm8953-mtp.dtsi"
#include "msm-pmi8950.dtsi"

