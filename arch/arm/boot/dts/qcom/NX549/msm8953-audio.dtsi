/*
 * Copyright (c) 2015-2016, The Linux Foundation. All rights reserved.
 *
 * This program is free software; you can redistribute it and/or modify
 * it under the terms of the GNU General Public License version 2 and
 * only version 2 as published by the Free Software Foundation.
 *
 * This program is distributed in the hope that it will be useful,
 * but WITHOUT ANY WARRANTY; without even the implied warranty of
 * MERCHANTABILITY or FITNESS FOR A PARTICULAR PURPOSE.  See the
 * GNU General Public License for more details.
 */


&int_codec {
	qcom,model = "msm8953-snd-card-mtp";

        qcom,cdc-ext-amp-gpios = <&tlmm 25 0>;
	qcom,msm-mbhc-hphl-swh = <1>;
	qcom,msm-hs-micbias-type = "external";
	/delete-property/ qcom,cdc-us-euro-gpios;

	qcom,msm-gpios =
		"pri_i2s",
		"us_eu_gpio",
		"dmic_gpio",
		"comp_gpio";
	qcom,pinctrl-names =
		"all_off",
		"pri_i2s_act",
		"us_eu_gpio_act",
		"pri_i2s_us_eu_gpio_act",
		"dmic_act",
		"dmic_pri_i2s_act",
		"dmic_us_eu_gpio_act",
		"dmic_us_eu_gpio_pri_i2s_act",
		"comp_gpio_act",
		"comp_gpio_pri_i2s_act",
		"comp_gpio_us_eu_gpio_act",
		"comp_gpio_pri_i2s_us_eu_gpio_act",
		"comp_gpio_dmic_act",
		"comp_gpio_dmic_pri_i2s_act",
		"comp_gpio_dmic_us_eu_gpio_act",
		"comp_gpio_dmic_us_eu_gpio_pri_i2s_act";

	pinctrl-names =
		"all_off",
		"pri_i2s_act",
		"us_eu_gpio_act",
		"pri_i2s_us_eu_gpio_act",
		"dmic_act",
		"dmic_pri_i2s_act",
		"dmic_us_eu_gpio_act",
		"dmic_us_eu_gpio_pri_i2s_act",
		"comp_gpio_act",
		"comp_gpio_pri_i2s_act",
		"comp_gpio_us_eu_gpio_act",
		"comp_gpio_pri_i2s_us_eu_gpio_act",
		"comp_gpio_dmic_act",
		"comp_gpio_dmic_pri_i2s_act",
		"comp_gpio_dmic_us_eu_gpio_act",
		"comp_gpio_dmic_us_eu_gpio_pri_i2s_act";

	pinctrl-0 = <&cdc_pdm_lines_sus &cdc_pdm_comp_lines_sus
		&cdc_pdm_lines_2_sus &cross_conn_det_sus
		&cdc_dmic_clk_sus &cdc_dmic_lines_sus &pri_tlmm_ws_sus>;
	pinctrl-1 = <&cdc_pdm_lines_act &cdc_pdm_comp_lines_sus
		&cdc_pdm_lines_2_act &cross_conn_det_sus
		&cdc_dmic_clk_sus &cdc_dmic_lines_sus &pri_tlmm_ws_sus>;
	pinctrl-2 = <&cdc_pdm_lines_sus &cdc_pdm_comp_lines_sus
		&cdc_pdm_lines_2_sus &cross_conn_det_act
		&cdc_dmic_clk_sus &cdc_dmic_lines_sus &pri_tlmm_ws_sus>;
	pinctrl-3 = <&cdc_pdm_lines_act &cdc_pdm_comp_lines_sus
		&cdc_pdm_lines_2_act &cross_conn_det_act
		&cdc_dmic_clk_sus &cdc_dmic_lines_sus &pri_tlmm_ws_sus>;
	pinctrl-4 = <&cdc_pdm_lines_sus &cdc_pdm_comp_lines_sus
		&cdc_pdm_lines_2_sus &cross_conn_det_sus
		&cdc_dmic_clk_act &cdc_dmic_lines_act &pri_tlmm_ws_act>;
	pinctrl-5 = <&cdc_pdm_lines_act &cdc_pdm_comp_lines_sus
		&cdc_pdm_lines_2_act &cross_conn_det_sus
		&cdc_dmic_clk_act &cdc_dmic_lines_act &pri_tlmm_ws_act>;
	pinctrl-6 = <&cdc_pdm_lines_sus &cdc_pdm_comp_lines_sus
		&cdc_pdm_lines_2_sus &cross_conn_det_act
		&cdc_dmic_clk_act &cdc_dmic_lines_act &pri_tlmm_ws_act>;
	pinctrl-7 = <&cdc_pdm_lines_act &cdc_pdm_comp_lines_sus
		&cdc_pdm_lines_2_act &cross_conn_det_act
		&cdc_dmic_clk_act &cdc_dmic_lines_act &pri_tlmm_ws_act>;
	pinctrl-8 = <&cdc_pdm_lines_sus &cdc_pdm_comp_lines_act
		&cdc_pdm_lines_2_sus &cross_conn_det_sus
		&cdc_dmic_clk_sus &cdc_dmic_lines_sus &pri_tlmm_ws_sus>;
	pinctrl-9 = <&cdc_pdm_lines_act &cdc_pdm_comp_lines_act
		&cdc_pdm_lines_2_act &cross_conn_det_sus
		&cdc_dmic_clk_sus &cdc_dmic_lines_sus &pri_tlmm_ws_sus>;
	pinctrl-10 = <&cdc_pdm_lines_sus &cdc_pdm_comp_lines_act
		&cdc_pdm_lines_2_sus &cross_conn_det_act
		&cdc_dmic_clk_sus &cdc_dmic_lines_sus &pri_tlmm_ws_sus>;
	pinctrl-11 = <&cdc_pdm_lines_act &cdc_pdm_comp_lines_act
		&cdc_pdm_lines_2_act &cross_conn_det_act
		&cdc_dmic_clk_sus &cdc_dmic_lines_sus &pri_tlmm_ws_sus>;
	pinctrl-12 = <&cdc_pdm_lines_sus &cdc_pdm_comp_lines_act
		&cdc_pdm_lines_2_sus &cross_conn_det_sus
		&cdc_dmic_clk_act &cdc_dmic_lines_act &pri_tlmm_ws_act>;
	pinctrl-13 = <&cdc_pdm_lines_act &cdc_pdm_comp_lines_act
		&cdc_pdm_lines_2_act &cross_conn_det_sus
		&cdc_dmic_clk_act &cdc_dmic_lines_act &pri_tlmm_ws_act>;
	pinctrl-14 = <&cdc_pdm_lines_sus &cdc_pdm_comp_lines_act
		&cdc_pdm_lines_2_sus &cross_conn_det_act
		&cdc_dmic_clk_act &cdc_dmic_lines_act &pri_tlmm_ws_act>;
	pinctrl-15 = <&cdc_pdm_lines_act &cdc_pdm_comp_lines_act
		&cdc_pdm_lines_2_act &cross_conn_det_act
		&cdc_dmic_clk_act &cdc_dmic_lines_act &pri_tlmm_ws_act>;

	/delete-property/ asoc-wsa-codec-names;
	/delete-property/ asoc-wsa-codec-prefixes;
	/delete-property/ msm-vdd-wsa-switch-supply;
	/delete-property/ qcom,msm-vdd-wsa-switch-voltage;
	/delete-property/ qcom,msm-vdd-wsa-switch-current;
};


&ext_codec {
	qcom,model = "msm8953-tasha-snd-card";

	qcom,msm-mbhc-hphl-swh = <0>;
	qcom,msm-mbhc-gnd-swh = <0>;
	/delete-property/ qcom,cdc-us-euro-gpios;
	/delete-property/ qcom,wsa-devs;
	/delete-property/ qcom,wsa-aux-dev-prefix;
	/delete-property/ qcom,wsa-max-devs;

};

