/*
 * Copyright (c) 2015-2016, The Linux Foundation. All rights reserved.
 *
 * This program is free software; you can redistribute it and/or modify
 * it under the terms of the GNU General Public License version 2 and
 * only version 2 as published by the Free Software Foundation.
 *
 * This program is distributed in the hope that it will be useful,
 * but WITHOUT ANY WARRANTY; without even the implied warranty of
 * MERCHANTABILITY or FITNESS FOR A PARTICULAR PURPOSE.  See the
 * GNU General Public License for more details.
 */


&int_codec {
	qcom,msm-mbhc-hphl-swh = <1>;
	/delete-property/ asoc-wsa-codec-names;
	/delete-property/ asoc-wsa-codec-prefixes;
	/delete-property/ msm-vdd-wsa-switch-supply;
	/delete-property/ qcom,msm-vdd-wsa-switch-voltage;
	/delete-property/ qcom,msm-vdd-wsa-switch-current;
};

&ext_codec {
	/delete-property/ qcom,wsa-max-devs;
	/delete-property/ qcom,wsa-devs;
	/delete-property/ qcom,wsa-aux-dev-prefix;
	/delete-property/ qcom,cdc-us-euro-gpios;

};

