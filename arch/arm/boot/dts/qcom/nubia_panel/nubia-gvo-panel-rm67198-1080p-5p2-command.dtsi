/* Copyright (c) 2013, The Linux Foundation. All rights reserved.
 *
 * This program is free software; you can redistribute it and/or modify
 * it under the terms of the GNU General Public License version 2 and
 * only version 2 as published by the Free Software Foundation.
 *
 * This program is distributed in the hope that it will be useful,
 * but WITHOUT ANY WARRANTY; without even the implied warranty of
 * MERCHANTABILITY or FITNESS FOR A PARTICULAR PURPOSE.  See the
 * GNU General Public License for more details.
 */

/*---------------------------------------------------------------------------
 * This file is autogenerated file using gcdb parser. Please do not edit it.
 * Update input XML file to add a new entry or update variable in this file
 * VERSION = "1.0"
 *---------------------------------------------------------------------------*/
&mdss_mdp {
	dsi_gvo_rm67198_1080_5p2_cmd: qcom,mdss_dsi_gvo_rm67198_1080p_5p2_command {
		qcom,mdss-dsi-panel-name = "gvo rm67198 1080p 5p2 command mode dsi panel";
		qcom,mdss-dsi-panel-controller = <&mdss_dsi0>;
		qcom,mdss-dsi-panel-type = "dsi_cmd_mode";
		qcom,mdss-dsi-panel-destination = "display_1";
		qcom,mdss-dsi-panel-framerate = <60>;
		qcom,mdss-dsi-virtual-channel-id = <0>;
		qcom,mdss-dsi-stream = <0>;
		qcom,mdss-dsi-panel-width = <1080>;
		qcom,mdss-dsi-panel-height = <1920>;
		qcom,mdss-dsi-h-front-porch = <60>;
		qcom,mdss-dsi-h-back-porch = <60>;
		qcom,mdss-dsi-h-pulse-width = <4>;
		qcom,mdss-dsi-h-sync-skew = <0>;
		qcom,mdss-dsi-v-back-porch = <4>;
		qcom,mdss-dsi-v-front-porch = <8>;
		qcom,mdss-dsi-v-pulse-width = <4>;
		qcom,mdss-dsi-h-left-border = <0>;
		qcom,mdss-dsi-h-right-border = <0>;
		qcom,mdss-dsi-v-top-border = <0>;
		qcom,mdss-dsi-v-bottom-border = <0>;
		qcom,mdss-dsi-bpp = <24>;
		qcom,mdss-dsi-color-order = <0>;
		qcom,mdss-dsi-underflow-color = <0xff>;
		qcom,mdss-dsi-border-color = <0>;
		qcom,mdss-dsi-lane-map = "lane_map_0123";
		qcom,mdss-dsi-panel-orientation = "180";
                qcom,mdss-dsi-on-command = [
15 01 00 00 00 00 02 FE 40
15 01 00 00 00 00 02 79 13
15 01 00 00 00 00 02 FE 60
15 01 00 00 00 00 02 5F CE
15 01 00 00 00 00 02 FE 70
15 01 00 00 00 00 02 7D 75
//15 01 00 00 00 00 02 9A 31
//15 01 00 00 00 00 02 99 00
//15 01 00 00 00 00 02 9E 21
//15 01 00 00 00 00 02 9F 03
15 01 00 00 00 00 02 FE F0
15 01 00 00 00 00 02 00 EF
15 01 00 00 00 00 02 09 25
15 01 00 00 00 00 02 0C DC
15 01 00 00 00 00 02 FE 80
15 01 00 00 00 00 02 00 0A
15 01 00 00 00 00 02 01 09
15 01 00 00 00 00 02 08 00
15 01 00 00 00 00 02 09 00
15 01 00 00 00 00 02 0A 00
15 01 00 00 00 00 02 0B 00
15 01 00 00 00 00 02 0C 00
15 01 00 00 00 00 02 0D 00
15 01 00 00 00 00 02 15 00
15 01 00 00 00 00 02 16 0B
15 01 00 00 00 00 02 1A 10
15 01 00 00 00 00 02 FE 00
15 01 00 00 00 00 02 C2 08
15 01 00 00 00 00 02 35 00
15 01 00 00 00 00 02 5A 0B
//15 01 00 00 00 00 02 55 00
15 01 00 00 64 00 02 11 00
15 01 00 00 00 00 02 29 00
15 01 00 00 32 00 02 51 00
15 01 00 00 00 00 02 FE 0F
		];
		qcom,mdss-dsi-off-command = [
			15 01 00 00 00 00 02 FE 00
			39 01 00 00 22 00 02 28 00
			39 01 00 00 78 00 02 10 00];
/*
                nubia,mdss-dsi-cabc-command-off = [
                        15 01 00 00 00 00 02 FE 00
                        15 01 00 00 00 00 02 55 00
                        15 01 00 00 00 00 02 FE 0F
                ];
                nubia,mdss-dsi-cabc-command-level1 = [
                        15 01 00 00 00 00 02 FE 00
                        15 01 00 00 00 00 02 55 03
                        15 01 00 00 00 00 02 00 00
                ];
                nubia,mdss-dsi-cabc-command-level2 = [
                        15 01 00 00 00 00 02 FE 00
                        15 01 00 00 00 00 02 55 02
                        15 01 00 00 00 00 02 FE 0F
                ];
                nubia,mdss-dsi-cabc-command-level3 = [
                        15 01 00 00 00 00 02 FE 00
                        15 01 00 00 00 00 02 55 01
                        15 01 00 00 00 00 02 FE 0F
                ];
*/
	        nubia,mdss-dsi-panel-backlight-curve = [
                        00 03 03 03 03 03 03 03
                        03 03 03 03 03 04 04 04
                        04 04 04 04 04 04 04 04
                        04 05 05 05 05 05 05 05
                        06 06 06 06 06 06 06 07
                        07 07 07 07 07 08 08 08
                        08 08 09 09 09 09 09 0a
                        0a 0a 0a 0b 0b 0b 0b 0c
                        0c 0c 0c 0d 0d 0d 0d 0e
                        0e 0e 0f 0f 0f 10 10 11
                        11 11 12 12 13 13 14 14
                        15 15 16 17 18 19 1a 1b
                        1c 1d 1e 1f 20 21 22 23
                        23 24 25 26 27 27 28 29
                        29 2a 2b 2c 2c 2d 2e 2f
                        30 31 31 32 33 34 34 35
                        36 37 38 39 3a 3b 3c 3f
                        40 41 42 43 44 45 46 47
                        48 49 4b 4c 4d 4e 50 51
                        52 53 55 56 57 58 5a 5b
                        5c 5d 5e 5f 61 62 63 64
                        65 66 68 69 6b 6c 6d 6f
                        70 71 72 73 75 76 77 78
                        79 7a 7c 7d 7e 7f 81 82
                        83 85 87 88 8a 8c 8e 8f
                        91 93 94 96 97 99 9a 9c
                        9d 9f a1 a3 a5 a7 a9 ab
                        ad af b1 b2 b4 b6 b8 b9
                        bb bd bf c1 c4 c6 c8 ca
                        cc ce d0 d2 d5 d7 d9 db
                        dd df e1 e3 e6 e9 ec f0
                        f4 f8 f9 fa fb fc ff ff
		];

		qcom,mdss-dsi-on-command-state = "dsi_lp_mode";
		qcom,mdss-dsi-off-command-state = "dsi_hs_mode";
		zte,mdss-dsi-ce-command-state = "dsi_lp_mode";
		zte,mdss-dsi-cabc-command-state = "dsi_lp_mode";
		zte,mdss-dsi-ce-cabc-command-state = "dsi_lp_mode";
		qcom,mdss-dsi-h-sync-pulse = <1>;
		qcom,mdss-dsi-traffic-mode = "burst_mode";
		qcom,mdss-dsi-bllp-eof-power-mode;
		qcom,mdss-dsi-bllp-power-mode;
		qcom,mdss-dsi-lane-0-state;
		qcom,mdss-dsi-lane-1-state;
		qcom,mdss-dsi-lane-2-state;
		qcom,mdss-dsi-lane-3-state;
		//command need start
		qcom,mdss-dsi-te-pin-select = <1>;
		//qcom,mdss-dsi-wr-mem-start = <0x2c>;
		qcom,mdss-dsi-te-dcs-command = <1>;
		qcom,mdss-dsi-te-check-enable;
		qcom,mdss-dsi-te-using-te-pin;
		//command need end
		qcom,mdss-dsi-panel-timings = [E2 36 24 00 66 6A 28 38 2A 03 04 00];
		qcom,mdss-dsi-t-clk-post = <0x03>;
		qcom,mdss-dsi-t-clk-pre = <0x2D>;
		qcom,mdss-dsi-bl-min-level = <1>;
		qcom,mdss-dsi-bl-max-level = <255>;
		zte,mdss-dsi-colortmp-warm = <0x8000 0x8000 0x7c7c>;
		zte,mdss-dsi-colortmp-natural = <0x8000 0x8000 0x8000>;
		zte,mdss-dsi-colortmp-cool = <0x7d80 0x7d76 0x8000>;
		qcom,mdss-dsi-dma-trigger = "trigger_sw";
		qcom,mdss-dsi-mdp-trigger = "none";
		qcom,mdss-dsi-bl-pmic-control-type = "bl_ctrl_dcs";
		qcom,mdss-dsi-reset-sequence = <1 1>, <1 1>, <1 8>;
		qcom,mdss-pan-physical-width-dimension = <59>;
		qcom,mdss-pan-physical-height-dimension = <104>;
		qcom,mdss-dsi-tx-eot-append;
	};
};
